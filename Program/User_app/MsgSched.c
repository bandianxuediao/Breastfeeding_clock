#include "includes.h"
#include "stm32f10x.h"

static SYS_STATE sys_state = GPIO_INIT;
static BACKUP_STATE  backup_state_buffer;


//==================================================================================================
//| 函数名称 | GetCurrentState 
//|----------|--------------------------------------------------------------------------------------
//| 函数功能 | 获取当前系统状态
//|----------|--------------------------------------------------------------------------------------
//| 输入参数 | 无
//|----------|--------------------------------------------------------------------------------------       
//| 返回参数 | 当前系统状态
//|----------|--------------------------------------------------------------------------------------       
//| 函数设计 | 编写人：李亚东    时间：2016-08-25 
//|----------|-------------------------------------------------------------------------------------- 
//|   备注   | 
//|----------|-------------------------------------------------------------------------------------- 
//| 修改记录 | 修改人：          时间：         修改内容： 
//==================================================================================================
SYS_STATE GetCurrentState(void)
{
	return sys_state;
}

//==================================================================================================
//| 函数名称 | SetCurrentState 
//|----------|--------------------------------------------------------------------------------------
//| 函数功能 | 根据输入的状态设置当前系统状态
//|----------|--------------------------------------------------------------------------------------
//| 输入参数 | 要设置的系统状态
//|----------|--------------------------------------------------------------------------------------       
//| 返回参数 | 无
//|----------|--------------------------------------------------------------------------------------       
//| 函数设计 | 编写人：李亚东    时间：2016-08-25 
//|----------|-------------------------------------------------------------------------------------- 
//|   备注   | 
//|----------|-------------------------------------------------------------------------------------- 
//| 修改记录 | 修改人：          时间：         修改内容： 
//==================================================================================================
void SetCurrentState(SYS_STATE state)
{
	sys_state = state;
}

//==================================================================================================
//| 函数名称 | BackupState
//|----------|--------------------------------------------------------------------------------------
//| 函数功能 | 备份当前输入状态
//|----------|--------------------------------------------------------------------------------------
//| 输入参数 | 要备份的系统状态
//|----------|--------------------------------------------------------------------------------------       
//| 返回参数 | SUCCESS  备份成功  ERROR 备份失败
//|----------|--------------------------------------------------------------------------------------       
//| 函数设计 | 编写人：李亚东    时间：2016-08-25 
//|----------|-------------------------------------------------------------------------------------- 
//|   备注   | 最多可备份SAVE_STATE_MAX_NUM个状态
//|----------|-------------------------------------------------------------------------------------- 
//| 修改记录 | 修改人：          时间：         修改内容： 
//==================================================================================================
ErrorStatus BackupState(SYS_STATE state)
{
	if(backup_state_buffer.num < SAVE_STATE_MAX_NUM)
	{
		backup_state_buffer.state[backup_state_buffer.num++] = state;
		return SUCCESS;
	}
	return ERROR;	
}

//==================================================================================================
//| 函数名称 | RestoreBackupState 
//|----------|--------------------------------------------------------------------------------------
//| 函数功能 | 恢复备份的状态
//|----------|--------------------------------------------------------------------------------------
//| 输入参数 | 用于保存从备份列表中得到的状态
//|----------|--------------------------------------------------------------------------------------       
//| 返回参数 | SUCCESS  恢复备份成功  ERROR 恢复备份失败
//|----------|--------------------------------------------------------------------------------------       
//| 函数设计 | 编写人：李亚东    时间：2016-08-25 
//|----------|-------------------------------------------------------------------------------------- 
//|   备注   | 
//|----------|-------------------------------------------------------------------------------------- 
//| 修改记录 | 修改人：          时间：         修改内容： 
//==================================================================================================
ErrorStatus RestoreBackupState(SYS_STATE* state)
{
	if(backup_state_buffer.num != 0)
	{
		*state = backup_state_buffer.state[--backup_state_buffer.num];
		return SUCCESS;
	}	
	return ERROR;
}
//==================================================================================================
//| 函数名称 | RemoveBackupState 
//|----------|--------------------------------------------------------------------------------------
//| 函数功能 | 删除备份的状态
//|----------|--------------------------------------------------------------------------------------
//| 输入参数 | 无
//|----------|--------------------------------------------------------------------------------------       
//| 返回参数 | 无
//|----------|--------------------------------------------------------------------------------------       
//| 函数设计 | 编写人：李亚东    时间：2016-08-25 
//|----------|-------------------------------------------------------------------------------------- 
//|   备注   | 
//|----------|-------------------------------------------------------------------------------------- 
//| 修改记录 | 修改人：          时间：         修改内容： 
//==================================================================================================
void RemoveBackupState(void)
{
	backup_state_buffer.num = 0;
}

//==================================================================================================
//| 函数名称 | MsgSched 
//|----------|--------------------------------------------------------------------------------------
//| 函数功能 | 消息调度函数,为输入的待处理消息查找对应的响应函数
//|----------|--------------------------------------------------------------------------------------
//| 输入参数 | msg 指向待处理消息
//|----------|--------------------------------------------------------------------------------------       
//| 返回参数 | 无
//|----------|--------------------------------------------------------------------------------------       
//| 函数设计 | 编写人：李亚东    时间：2016-08-25 
//|----------|-------------------------------------------------------------------------------------- 
//|   备注   | 
//|----------|-------------------------------------------------------------------------------------- 
//| 修改记录 | 修改人：          时间：         修改内容： 
//==================================================================================================
void MsgSched(MSG msg)
{
	u8 i;
	const struct SCHED_CODE SchedMsg[] = {   //创建一个const的SCHED_CODE类型的数组，将待处理消息和相关函数对应起来
		CONNECT,  ConnectPro,
		NULL_CODE, NullPro,
		KEY_0, Key0Pro,
		KEY_1, Key1Pro,
		KEY_2, Key2Pro,
		KEY_3, Key3Pro,
		KEY_4, Key4Pro,
		KEY_5, Key5Pro,
		KEY_6, Key6Pro,
		KEY_7, Key7Pro,
		KEY_8, Key8Pro,
		KEY_9, Key9Pro,
		KEY_IN, KeyInPro,
		KEY_OUT, KeyOutPro,
		KEY_SURE, KeySurePro,	
		KEY_SYS, KeySysPro,
		KEY_KEY, KeyKeyPro,		
		KEY_BACK, KeyBackPro		

	};

	for (i = 0; i < dim(SchedMsg); i++)  //dim(x)=(sizeof(x)/sizeof(x[0]))  计算SchedMsg一共有多少组数据
	{
		if (msg.code == SchedMsg[i].code)  //如果队列中传过来的事件和SchedMsg中的事件相同的话
		{
			(*SchedMsg[i].Fxn)(msg);         //就代入Fxn 得到需要运行的函数
			return;                          //因为刚开始消息队列为空，所以返回null，执行函数  NullPro(msg)
		}                                  //系统状态就开始发生改变，等到初始化完成之后才可以通过SysTick触发按键
	}	
}





